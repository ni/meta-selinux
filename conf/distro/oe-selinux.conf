## conf/distro/oe-selinux.conf
```bitbake
DISTRO = "oe-selinux"
DISTROOVERRIDES .= ":selinux"

DISTRO_FEATURES_append = "pam selinux"
```

## conf/distro/poky-selinux.conf
```bitbake
require conf/distro/poky.conf

DISTRO = "poky-selinux"
DISTROOVERRIDES = "poky:selinux"

DISTRO_FEATURES_append = " pam selinux"
```

## conf/layer.conf
```bitbake
# We have a conf and classes directory, add to BBPATH
BBPATH .= ":${LAYERDIR}"

# We have a packages directory, add to BBFILES
BBFILES += "${LAYERDIR}/recipes-*/*/*.bb \
            ${LAYERDIR}/recipes-*/*/*.bbappend"

BBFILES_DYNAMIC += "openembedded-layer:${LAYERDIR}/dynamic-layers/openembedded-layer/*/*/*.bb \
                    openembedded-layer:${LAYERDIR}/dynamic-layers/openembedded-layer/*/*/*.bbappend \
                    networking-layer:${LAYERDIR}/dynamic-layers/networking-layer/*/*/*.bb \
                    networking-layer:${LAYERDIR}/dynamic-layers/networking-layer/*/*/*.bbappend \
                    virtualization-layer:${LAYERDIR}/dynamic-layers/virtualization-layer/recipes*/*/*.bb \
                    virtualization-layer:${LAYERDIR}/dynamic-layers/virtualization-layer/recipes*/*/*.bbappend \
                    meta-python2:${LAYERDIR}/dynamic-layers/python2-layer/recipes*/*/*.bb \
                    meta-python2:${LAYERDIR}/dynamic-layers/python2-layer/recipes*/*/*.bbappend \
                   "

BBFILE_COLLECTIONS += "selinux"
BBFILE_PATTERN_selinux = "^${LAYERDIR}/"
BBFILE_PRIORITY_selinux = "5"

# This should only be incremented on significant changes that will
# cause compatibility issues with other layers
LAYERVERSION_selinux = "1"

LAYERSERIES_COMPAT_selinux = "dunfell"

LAYERDEPENDS_selinux = " \
    core \
    meta-python \
"
```
